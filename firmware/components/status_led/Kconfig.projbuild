## firmware/components/status_led/Kconfig.projbuild
```kconfig
menu "Status LED"
    config STATUS_LED_ENABLE
        bool "Enable status LED (power/connection blink-pattern indicator)"
        default n
        help
            Drives a single GPIO with a blink pattern to convey device state,
            since most small boards (e.g. Seeed XIAO ESP32-S3) only expose
            one software-controllable LED:
              - fast blink: no WiFi (booting or disconnected)
              - slow blink: WiFi connected, not yet streaming audio
              - solid on:   audio actively streaming (ready)

    config STATUS_LED_GPIO
        int "Status LED GPIO number"
        depends on STATUS_LED_ENABLE
        default 21
        help
            Default 21 is the XIAO ESP32-S3's onboard user LED (amber).

    config STATUS_LED_ACTIVE_LOW
        bool "Status LED is active-low"
        depends on STATUS_LED_ENABLE
        default y
        help
            The XIAO ESP32-S3's onboard LED is active-low (GPIO LOW = lit).
endmenu
```
